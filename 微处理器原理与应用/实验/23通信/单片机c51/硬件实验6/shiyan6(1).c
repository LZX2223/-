#include <reg52.h>
#include <INTRINS.H>
#define uchar unsigned char
#define uint unsigned int

int i,j;
const uchar code a[][32]=
	{
	0x00,0x00,0xC0,0x38,0xE0,0x00,0x00,0x00,0x00,0x00,0x00,0x00,0x00,0x00,0x00,0x00,0x20,0x3C,0x23,0x02,0x02,0x27,0x38,0x20,0x00,0x00,0x00,0x00,0x00,0x00,0x00,0x00,
	0x18,0x08,0x08,0xF8,0x08,0x08,0x18,0x00,0x00,0x00,0x00,0x00,0x00,0x00,0x00,0x00,0x00,0x00,0x20,0x3F,0x20,0x00,0x00,0x00,0x00,0x00,0x00,0x00,0x00,0x00,0x00,0x00,
	0x00,0x70,0x88,0x08,0x08,0x88,0x70,0x00,0x00,0x00,0x00,0x00,0x00,0x00,0x00,0x00,0x00,0x1C,0x22,0x21,0x21,0x22,0x1C,0x00,0x00,0x00,0x00,0x00,0x00,0x00,0x00,0x00,	
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	0x00,0x00,0xF0,0x10,0x10,0x10,0x10,0xFF,0x10,0x10,0x10,0x10,0xF0,0x00,0x00,0x00,0x00,0x00,0x0F,0x04,0x04,0x04,0x04,0xFF,0x04,0x04,0x04,0x04,0x0F,0x00,0x00,0x00
	};
	
sbit RST=P2^0;
sbit E=P2^2;
sbit RW=P2^3;
sbit RS=P2^4;
sbit CS1=P2^5;
sbit CS2=P2^6;


void Delayms(unsigned int xms)
{
    unsigned char i, j;
    while (xms--)
    {
        i = 2;
        j = 239;
        do
        {
            while (--j);
        } while (--i);
    }
}
void Delayus(unsigned int xms)
{
    unsigned char i, j;
    while (xms--)
    {
        i = 2;
        j = 24;
        do
        {
            while (--j);
        } while (--i);
    }
}
void Check_busy() 
{ 
	uchar a; 
	RW=1; 
	RS=0; 
	E=1;
	while(1) 
	{ 
		E=0;
		if(!(P1&0x80))
		break;
		E=1; 
		a++; 
		if(a>10)
		break; 
	} 
}
void write_cmd(unsigned char a) 
{ 
	Check_busy(); 
	RS=0; 
	RW=0; 
	E=0;
	P0=a; 
  Delayms(10);	
	E=1; 
  Delayms(10);
	E=0; 
} 
void write_data(unsigned char a) 
{ 
	Check_busy(); 
	RS=1; 
	RW=0;
	E=0;
	P0=a;
  Delayms(10);	
	E=1; 
  Delayms(10);	
	E=0; 
}
void LCD_Init() 
{ 
	write_cmd(0x30);
	Delayus(10); 
//	write_cmd(0x0c);
//	Delayus(10); 
//	write_cmd(0x01);
//	Delayms(10); 
//	write_cmd(0x06);
//	Delayus(10);
} 
void set_xy(unsigned char x,unsigned char y)//x??, y??
{ 
	if(y>=64)
	{
		CS1=1; 
		CS2=0; 
		y=y-64; 
	} 
	else
	{
		CS2=1; 	
		CS1=0; 
	} 
write_cmd(0x40|y);//DDRAM
write_cmd(0xb8|x);
}

void Disp_hz(unsigned char R,unsigned char L,unsigned char *p) 
{ 
uchar i; 
for(i=0;i<16;i++) 
{ 
set_xy(2*R,16*L+i);
write_data(p[i]); 
//set_xy(2*R+1,16*L+i); 
//write_data(p[i+16]); 
} 
}

void main()
{
	LCD_Init();
for(i=0;i<18;i++)
		{
			if(i>=16)
			{
				j=2;
				Disp_hz(j,i-16,a[i]);
			}
			else if(i>=8)
			{
				j=1;
				Disp_hz(j,i-8,a[i]);
			}
				else
			{
				j=0;
				Disp_hz(j,i,a[i]);
			}
		}
		Delayus(1); 
	while (1)
	{
		
	}
}