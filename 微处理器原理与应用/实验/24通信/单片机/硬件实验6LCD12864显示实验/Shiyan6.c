#include <reg52.h>
#include <INTRINS.H>
#define uchar unsigned char
#define uint unsigned int

int i,j;
const uchar code a[][32]=
	{
	0x00,0x00,0xC0,0x38,0xE0,0x00,0x00,0x00,0x00,0x00,0x00,0x00,0x00,0x00,0x00,0x00,0x20,0x3C,0x23,0x02,0x02,0x27,0x38,0x20,0x00,0x00,0x00,0x00,0x00,0x00,0x00,0x00,
	0x18,0x08,0x08,0xF8,0x08,0x08,0x18,0x00,0x00,0x00,0x00,0x00,0x00,0x00,0x00,0x00,0x00,0x00,0x20,0x3F,0x20,0x00,0x00,0x00,0x00,0x00,0x00,0x00,0x00,0x00,0x00,0x00,
	0x00,0x70,0x88,0x08,0x08,0x88,0x70,0x00,0x00,0x00,0x00,0x00,0x00,0x00,0x00,0x00,0x00,0x1C,0x22,0x21,0x21,0x22,0x1C,0x00,0x00,0x00,0x00,0x00,0x00,0x00,0x00,0x00,	
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	0x00,0x00,0xF0,0x10,0x10,0x10,0x10,0xFF,0x10,0x10,0x10,0x10,0xF0,0x00,0x00,0x00,0x00,0x00,0x0F,0x04,0x04,0x04,0x04,0xFF,0x04,0x04,0x04,0x04,0x0F,0x00,0x00,0x00
	};
	
sbit RST=P2^0;
sbit E=P2^2;
sbit RW=P2^3;
sbit RS=P2^4;
sbit CS1=P2^5;
sbit CS2=P2^6;


void Delayms(unsigned int xms)
{
    unsigned char i, j;
    while (xms--)
    {
        i = 2;
        j = 239;
        do
        {
            while (--j);
        } while (--i);
    }
}
void Delayus(unsigned int xms)
{
    unsigned char i, j;
    while (xms--)
    {
        i = 2;
        j = 24;
        do
        {
            while (--j);
        } while (--i);
    }
}
void Check_busy()
{
    Delayus(20);
}

void write_cmd(uchar cmd)
{
    RS=0;
    RW=0;

    P0=cmd;

    E=1;
    _nop_();
    _nop_();
    E=0;

    Delayus(20);
}

void write_data(uchar dat)
{
    RS=1;
    RW=0;

    P0=dat;

    E=1;
    _nop_();
    _nop_();
    E=0;

    Delayus(20);
}

void LCD_Init()
{
    RST=1;

    CS1=1;
    CS2=1;

    write_cmd(0x3F);
    write_cmd(0xC0);
    write_cmd(0xB8);
    write_cmd(0x40);

    Delayms(20);
}

void set_xy(uchar page,uchar col)
{
    if(col<64)
    {
        CS1=0;
        CS2=1;
    }
    else
    {
        CS1=1;
        CS2=0;
        col-=64;
    }

    write_cmd(0xB8+page);
    write_cmd(0x40+col);
}

void Disp_hz(uchar page,uchar col,uchar *p)
{
    uchar i;

    for(i=0;i<16;i++)
    {
        set_xy(page,col+i);
        write_data(p[i]);
    }

    for(i=0;i<16;i++)
    {
        set_xy(page+1,col+i);
        write_data(p[i+16]);
    }
}

void main()
{
    LCD_Init();

    // 第一行：只写 AT89C51（a[0]~a[6]），不写“单”
    for(i=0;i<7;i++)
    {
        Disp_hz(0,i*16,(uchar *)a[i]);
    }

    // 第二行：先写“单”，再写“片机第六次实验”
    Disp_hz(2,0*16,(uchar *)a[7]);  // 单
    Disp_hz(2,1*16,(uchar *)a[8]);  // 片
    Disp_hz(2,2*16,(uchar *)a[9]);  // 机
    for(i=10;i<=14;i++)               // 第六次实验
    {
        Disp_hz(2,(i-7)*16,(uchar *)a[i]);
    }

    while(1);
}